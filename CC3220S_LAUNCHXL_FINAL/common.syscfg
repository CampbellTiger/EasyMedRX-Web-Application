/**
 * @cliArgs --board "/ti/boards/CC3220S_LAUNCHXL" --rtos "tirtos7" --product "simplelink_cc32xx_sdk@7.10.00.13"
 * @versions {"tool":"1.20.0+3587"}
 */

/**
 * Import the modules used in this configuration.
 */
const DriverLib      = scripting.addModule("/ti/devices/DriverLib");
const Display        = scripting.addModule("/ti/display/Display");
const Display1       = Display.addInstance();
const ADC            = scripting.addModule("/ti/drivers/ADC", {}, false);
const ADC1           = ADC.addInstance();
const Board          = scripting.addModule("/ti/drivers/Board");
const Crypto         = scripting.addModule("/ti/drivers/Crypto");
const Crypto1        = Crypto.addInstance();
const DMA            = scripting.addModule("/ti/drivers/DMA");
const GPIO           = scripting.addModule("/ti/drivers/GPIO");
const GPIO2          = GPIO.addInstance();
const GPIO3          = GPIO.addInstance();
const GPIO4          = GPIO.addInstance();
const GPIO5          = GPIO.addInstance();
const GPIO6          = GPIO.addInstance();
const GPIO7          = GPIO.addInstance();
const GPIO8          = GPIO.addInstance();
const GPIO9          = GPIO.addInstance();
const GPIO10         = GPIO.addInstance();
const GPIO11         = GPIO.addInstance();
const PWM            = scripting.addModule("/ti/drivers/PWM", {}, false);
const PWM1           = PWM.addInstance();
const Power          = scripting.addModule("/ti/drivers/Power");
const SPI            = scripting.addModule("/ti/drivers/SPI");
const SPI1           = SPI.addInstance();
const Watchdog       = scripting.addModule("/ti/drivers/Watchdog");
const Watchdog1      = Watchdog.addInstance();
const SimpleLinkWifi = scripting.addModule("/ti/drivers/net/wifi/SimpleLinkWifi");
const atcmd          = scripting.addModule("/ti/drivers/net/wifi/atcmd", {}, false);
const atcmd1         = atcmd.addInstance();
const net_utils      = scripting.addModule("/ti/drivers/net/wifi/net_utils", {}, false);
const net_utils1     = net_utils.addInstance();
const HTTPClient     = scripting.addModule("/ti/net/HTTPClient", {}, false);
const HTTPClient1    = HTTPClient.addInstance();
const MQTT           = scripting.addModule("/ti/net/MQTT", {}, false);
const MQTT1          = MQTT.addInstance();
const SNTP           = scripting.addModule("/ti/net/SNTP");
const SlNet          = scripting.addModule("/ti/net/SlNet");
const SlNet1         = SlNet.addInstance();
const Settings       = scripting.addModule("/ti/posix/tirtos/Settings");
const BIOS           = scripting.addModule("/ti/sysbios/BIOS");
const Event          = scripting.addModule("/ti/sysbios/knl/Event");
const Idle           = scripting.addModule("/ti/sysbios/knl/Idle", {}, false);
const Idle2          = Idle.addInstance();
const Mailbox        = scripting.addModule("/ti/sysbios/knl/Mailbox");
const Error          = scripting.addModule("/ti/sysbios/runtime/Error");
const SysCallback    = scripting.addModule("/ti/sysbios/runtime/SysCallback");
const Timestamp      = scripting.addModule("/ti/sysbios/runtime/Timestamp");
const JSON           = scripting.addModule("/ti/utils/JSON");

/**
 * Write custom configuration values to the imported modules.
 */
Display1.$name                          = "CONFIG_Display_0";
Display1.$hardware                      = system.deviceData.board.components.XDS110UART;
Display1.uart.$name                     = "CONFIG_UART2_0";
Display1.uart.uart.$assign              = "UART0";
Display1.uart.uart.txPin.$assign        = "GP01";
Display1.uart.uart.txDmaChannel.$assign = "UDMA_CH9";
Display1.uart.uart.rxPin.$assign        = "GP02";
Display1.uart.uart.rxDmaChannel.$assign = "UDMA_CH8";

ADC1.$name     = "CONFIG_ADC_0";
ADC1.$hardware = system.deviceData.board.components.OPA4342.subComponents.AIN3;

Crypto1.$name = "CONFIG_Crypto_0";

GPIO2.$name           = "CONFIG_GPIO_12";
GPIO2.mode            = "Output";
GPIO2.gpioPin.$assign = "boosterpack.4";

GPIO3.$name           = "CONFIG_GPIO_06";
GPIO3.mode            = "Output";
GPIO3.gpioPin.$assign = "boosterpack.5";

GPIO4.$name           = "CONFIG_GPIO_07";
GPIO4.mode            = "Output";
GPIO4.gpioPin.$assign = "boosterpack.8";

GPIO5.$name           = "CONFIG_GPIO_10";
GPIO5.mode            = "Output";
GPIO5.gpioPin.$assign = "boosterpack.9";
scripting.suppress("Connected to hardware,@@@.+?@@@ is connected to LaunchPad I2C on the CC3220S LaunchPad\\. Consider selecting it in \'use hardware\' above\\. @@@.+?@@@", GPIO5, "gpioPin");

GPIO6.$name           = "CONFIG_GPIO_11";
GPIO6.gpioPin.$assign = "boosterpack.10";
scripting.suppress("Connected to hardware,@@@.+?@@@ is connected to LaunchPad I2C on the CC3220S LaunchPad\\. Consider selecting it in \'use hardware\' above\\. @@@.+?@@@", GPIO6, "gpioPin");

GPIO7.$name              = "CONFIG_GPIO_08";
GPIO7.mode               = "Output";
GPIO7.initialOutputState = "High";
GPIO7.gpioPin.$assign    = "boosterpack.27";

GPIO8.$name           = "CONFIG_GPIO_30";
GPIO8.mode            = "Output";
GPIO8.gpioPin.$assign = "boosterpack.28";

GPIO9.$name              = "CONFIG_GPIO_09";
GPIO9.mode               = "Output";
GPIO9.initialOutputState = "High";
GPIO9.gpioPin.$assign    = "boosterpack.29";
scripting.suppress("Connected to hardware,@@@.+?@@@ is connected to LaunchPad LED D10 \\(Red\\) on the CC3220S LaunchPad\\. Consider selecting it in \'use hardware\' above\\. @@@.+?@@@", GPIO9, "gpioPin");

GPIO10.mode            = "Output";
GPIO10.$name           = "CONFIG_GPIO_00";
GPIO10.gpioPin.$assign = "boosterpack.30";

GPIO11.$name           = "CONFIG_GPIO_28";
GPIO11.mode            = "Output";
GPIO11.gpioPin.$assign = "boosterpack.19";

PWM1.$name                = "CONFIG_PWM_0";
PWM1.timer.$assign        = "Timer1";
PWM1.timer.pwmPin.$assign = "boosterpack.13";

Power.ioRetentionShutdown = ["GRP_1"];
Power.parkPins.$name      = "ti_drivers_power_PowerCC32XXPins0";

SPI1.$name                    = "CONFIG_SPI_0";
SPI1.mode                     = "Four Pin CS Active Low";
SPI1.defaultTxBufferValue     = "0";
SPI1.csnControl               = "SW";
SPI1.spi.$assign              = "SPI0";
SPI1.spi.sclkPin.$assign      = "boosterpack.7";
SPI1.spi.pociPin.$assign      = "boosterpack.14";
SPI1.spi.picoPin.$assign      = "boosterpack.15";
SPI1.spi.dmaRxChannel.$assign = "UDMA_CH6";
SPI1.spi.dmaTxChannel.$assign = "UDMA_CH7";
SPI1.spi.csnPin.$assign       = "boosterpack.18";

Watchdog1.$name            = "CONFIG_WATCHDOG_0";
Watchdog1.watchdog.$assign = "WATCHDOG0";

atcmd1.$name = "CONFIG_ATCMD_0";

net_utils1.$name = "CONFIG_NET_UTILS_0";

HTTPClient1.$name = "CONFIG_HTTPCLIENT_0";

MQTT1.$name = "CONFIG_MQTT_0";

SlNet1.$name  = "CONFIG_SLNET";
SlNet1.ifName = "CC32xx";

BIOS.assertsEnabled = false;
BIOS.heapBaseAddr   = "__primary_heap_start__";
BIOS.heapEndAddr    = "__primary_heap_end__";

const Hwi           = scripting.addModule("/ti/sysbios/family/arm/m3/Hwi", {}, false);
Hwi.enableException = false;

Idle2.$name   = "powerIdle";
Idle2.idleFxn = "Power_idleFunc";

const Semaphore            = scripting.addModule("/ti/sysbios/knl/Semaphore", {}, false);
Semaphore.supportsPriority = false;

const Task             = scripting.addModule("/ti/sysbios/knl/Task", {}, false);
Task.checkStackFlag    = false;
Task.defaultStackSize  = 512;
Task.idleTaskStackSize = 512;

Error.policy       = "Error_SPIN";
Error.printDetails = false;

const System           = scripting.addModule("/ti/sysbios/runtime/System", {}, false);
System.abortFxn        = "System_abortSpin";
System.exitFxn         = "System_exitSpin";
System.extendedFormats = "%f";
System.supportModule   = "SysCallback";

/**
 * Pinmux solution for unlocked pins/peripherals. This ensures that minor changes to the automatic solver in a future
 * version of the tool will not impact the pinmux you originally saw.  These lines can be completely deleted in order to
 * re-solve from scratch.
 */
ADC1.adc.$suggestSolution        = "ADC0";
ADC1.adc.adcPin.$suggestSolution = "boosterpack.26";
